## Kconfig
```kconfig
config ZMK_INPUT_PROCESSOR_MOTION_THRESHOLD
    bool "Motion threshold input processor"
    default y
    depends on ZMK_POINTING
    depends on DT_HAS_ZMK_INPUT_PROCESSOR_MOTION_THRESHOLD_ENABLED
    help
      Delay a delegated input processor until pointer movement exceeds a
      configurable displacement threshold.
```

## boards/shields/ZaruBall/Kconfig.defconfig
```kconfig
if SHIELD_ZARUBALL_RIGHT #ここを変えてセントラル側に問題のコードを移行

# Name must be less than 16 characters long!
config ZMK_KEYBOARD_NAME
    default "ZaruBall"

config ZMK_SPLIT_ROLE_CENTRAL
    default y

endif

if SHIELD_ZARUBALL_LEFT || SHIELD_ZARUBALL_RIGHT

config ZMK_SPLIT
    default y

endif

# Input Device(pmw3610)のためのコンフィグ
if SHIELD_ZARUBALL_RIGHT

# Other settings

config INPUT
    default y

config ZMK_POINTING
    default y

# Assuming pointing device uses SPI
config SPI
    default y

config PMW3610
    default y

endif
```

## dts/bindings/input_processors/zmk,input-processor-motion-threshold.yaml
```yaml
# Copyright (c) 2026 batao9
# SPDX-License-Identifier: MIT

description: Input processor that delegates after pointer displacement exceeds a threshold

compatible: "zmk,input-processor-motion-threshold"

include: ip_two_param.yaml

properties:
  delegate:
    type: phandle
    required: true
    description: Input processor to invoke after the movement threshold is reached

  threshold:
    type: int
    required: true
    description: Required net XY displacement in sensor counts

  activation-window-ms:
    type: int
    required: true
    description: Inactivity interval after which accumulated displacement is reset

  require-prior-idle-ms:
    type: int
    required: false
    default: 0
    description: Time that must pass after the last key press before accumulating movement
```
